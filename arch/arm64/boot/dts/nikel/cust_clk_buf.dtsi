/*
 * Generated by MTK SP DrvGen Version: 2.2.160113 for MT6797. Copyright MediaTek Inc. (C) 2015.
 * 01.18.2022 23:42:18
 * Do Not Modify the File.
 */

/*************************
 * CLK_BUF DTSI File
*************************/

&pmic_clock_buffer_ctrl {
	mediatek,clkbuf-quantity = <4>;
	mediatek,clkbuf-config = <0 0 0 0>;
	mediatek,clkbuf-drviving-current = <2 2 2 2>;
	status = "okay";
};
&rf_clock_buffer_ctrl {
	mediatek,clkbuf-quantity = <4>;
	mediatek,clkbuf-config = <2 0 1 1>;
	mediatek,clkbuf-driving-current = <2 2 2 2>;
	status = "okay";
};

