/*
 * Generated by MTK SP DrvGen Version: 2.2.160113 for MT6797. Copyright MediaTek Inc. (C) 2015.
 * 01.26.2023 12:49:49
 * Do Not Modify the File.
 */

/*************************
 * GPIO DTSI File
*************************/

&pio {

	gpio_pins_default: gpiodef{
	};

	gpio0: gpio@0 {
		pins_cmd_dat {
			pins = <PINMUX_GPIO0__FUNC_CSI0A_L0P_T0A>;
			slew-rate = <0>;
			bias-disable;
			bias-pull-down = <00>;
			output-low;
			input-schmitt-enable = <0>;
		};
	};
	gpio1: gpio@1 {
		pins_cmd_dat {
			pins = <PINMUX_GPIO1__FUNC_CSI0A_L0N_T0B>;
			slew-rate = <0>;
			bias-disable;
			bias-pull-down = <00>;
			output-low;
			input-schmitt-enable = <0>;
		};
	};
	gpio2: gpio@2 {
		pins_cmd_dat {
			pins = <PINMUX_GPIO2__FUNC_CSI0A_L1P_T0C>;
			slew-rate = <0>;
			bias-disable;
			bias-pull-down = <00>;
			output-low;
			input-schmitt-enable = <0>;
		};
	};
	gpio3: gpio@3 {
		pins_cmd_dat {
			pins = <PINMUX_GPIO3__FUNC_CSI0A_L1N_T1A>;
			slew-rate = <0>;
			bias-disable;
			bias-pull-down = <00>;
			output-low;
			input-schmitt-enable = <0>;
		};
	};
	gpio4: gpio@4 {
		pins_cmd_dat {
			pins = <PINMUX_GPIO4__FUNC_CSI0A_L2P_T1B>;
			slew-rate = <0>;
			bias-disable;
			bias-pull-down = <00>;
			output-low;
			input-schmitt-enable = <0>;
		};
	};
	gpio5: gpio@5 {
		pins_cmd_dat {
			pins = <PINMUX_GPIO5__FUNC_CSI0A_L2N_T1C>;
			slew-rate = <0>;
			bias-disable;
			bias-pull-down = <00>;
			output-low;
			input-schmitt-enable = <0>;
		};
	};
	gpio6: gpio@6 {
		pins_cmd_dat {
			pins = <PINMUX_GPIO6__FUNC_CSI0B_L0P_T0A>;
			slew-rate = <0>;
			bias-disable;
			bias-pull-down = <00>;
			output-low;
			input-schmitt-enable = <0>;
		};
	};
	gpio7: gpio@7 {
		pins_cmd_dat {
			pins = <PINMUX_GPIO7__FUNC_CSI0B_L0N_T0B>;
			slew-rate = <0>;
			bias-disable;
			bias-pull-down = <00>;
			output-low;
			input-schmitt-enable = <0>;
		};
	};
	gpio8: gpio@8 {
		pins_cmd_dat {
			pins = <PINMUX_GPIO8__FUNC_CSI0B_L1P_T0C>;
			slew-rate = <0>;
			bias-disable;
			bias-pull-down = <00>;
			output-low;
			input-schmitt-enable = <0>;
		};
	};
	gpio9: gpio@9 {
		pins_cmd_dat {
			pins = <PINMUX_GPIO9__FUNC_CSI0B_L1N_T1A>;
			slew-rate = <0>;
			bias-disable;
			bias-pull-down = <00>;
			output-low;
			input-schmitt-enable = <0>;
		};
	};
	gpio10: gpio@10 {
		pins_cmd_dat {
			pins = <PINMUX_GPIO10__FUNC_CSI1A_L0P_T0A>;
			slew-rate = <0>;
			bias-disable;
			bias-pull-down = <00>;
			output-low;
			input-schmitt-enable = <0>;
		};
	};
	gpio11: gpio@11 {
		pins_cmd_dat {
			pins = <PINMUX_GPIO11__FUNC_CSI1A_L0N_T0B>;
			slew-rate = <0>;
			bias-disable;
			bias-pull-down = <00>;
			output-low;
			input-schmitt-enable = <0>;
		};
	};
	gpio12: gpio@12 {
		pins_cmd_dat {
			pins = <PINMUX_GPIO12__FUNC_CSI1A_L1P_T0C>;
			slew-rate = <0>;
			bias-disable;
			bias-pull-down = <00>;
			output-low;
			input-schmitt-enable = <0>;
		};
	};
	gpio13: gpio@13 {
		pins_cmd_dat {
			pins = <PINMUX_GPIO13__FUNC_CSI1A_L1N_T1A>;
			slew-rate = <0>;
			bias-disable;
			bias-pull-down = <00>;
			output-low;
			input-schmitt-enable = <0>;
		};
	};
	gpio14: gpio@14 {
		pins_cmd_dat {
			pins = <PINMUX_GPIO14__FUNC_CSI1A_L2P_T1B>;
			slew-rate = <0>;
			bias-disable;
			bias-pull-down = <00>;
			output-low;
			input-schmitt-enable = <0>;
		};
	};
	gpio15: gpio@15 {
		pins_cmd_dat {
			pins = <PINMUX_GPIO15__FUNC_CSI1A_L2N_T1C>;
			slew-rate = <0>;
			bias-disable;
			bias-pull-down = <00>;
			output-low;
			input-schmitt-enable = <0>;
		};
	};
	gpio16: gpio@16 {
		pins_cmd_dat {
			pins = <PINMUX_GPIO16__FUNC_CSI1B_L0P_T0A>;
			slew-rate = <0>;
			bias-disable;
			bias-pull-down = <00>;
			output-low;
			input-schmitt-enable = <0>;
		};
	};
	gpio17: gpio@17 {
		pins_cmd_dat {
			pins = <PINMUX_GPIO17__FUNC_CSI1B_L0N_T0B>;
			slew-rate = <0>;
			bias-disable;
			bias-pull-down = <00>;
			output-low;
			input-schmitt-enable = <0>;
		};
	};
	gpio18: gpio@18 {
		pins_cmd_dat {
			pins = <PINMUX_GPIO18__FUNC_CSI1B_L1P_T0C>;
			slew-rate = <0>;
			bias-disable;
			bias-pull-down = <00>;
			output-low;
			input-schmitt-enable = <0>;
		};
	};
	gpio19: gpio@19 {
		pins_cmd_dat {
			pins = <PINMUX_GPIO19__FUNC_CSI1B_L1N_T1A>;
			slew-rate = <0>;
			bias-disable;
			bias-pull-down = <00>;
			output-low;
			input-schmitt-enable = <0>;
		};
	};
	gpio20: gpio@20 {
		pins_cmd_dat {
			pins = <PINMUX_GPIO20__FUNC_CSI1B_L2P_T1B>;
			slew-rate = <0>;
			bias-disable;
			bias-pull-down = <00>;
			output-low;
			input-schmitt-enable = <0>;
		};
	};
	gpio21: gpio@21 {
		pins_cmd_dat {
			pins = <PINMUX_GPIO21__FUNC_CSI1B_L2N_T1C>;
			slew-rate = <0>;
			bias-disable;
			bias-pull-down = <00>;
			output-low;
			input-schmitt-enable = <0>;
		};
	};
	gpio22: gpio@22 {
		pins_cmd_dat {
			pins = <PINMUX_GPIO22__FUNC_CSI2_L0P_T0A>;
			slew-rate = <0>;
			bias-disable;
			bias-pull-down = <00>;
			output-low;
			input-schmitt-enable = <0>;
		};
	};
	gpio23: gpio@23 {
		pins_cmd_dat {
			pins = <PINMUX_GPIO23__FUNC_CSI2_L0N_T0B>;
			slew-rate = <0>;
			bias-disable;
			bias-pull-down = <00>;
			output-low;
			input-schmitt-enable = <0>;
		};
	};
	gpio24: gpio@24 {
		pins_cmd_dat {
			pins = <PINMUX_GPIO24__FUNC_CSI2_L1P_T0C>;
			slew-rate = <0>;
			bias-disable;
			bias-pull-down = <00>;
			output-low;
			input-schmitt-enable = <0>;
		};
	};
	gpio25: gpio@25 {
		pins_cmd_dat {
			pins = <PINMUX_GPIO25__FUNC_CSI2_L1N_T1A>;
			slew-rate = <0>;
			bias-disable;
			bias-pull-down = <00>;
			output-low;
			input-schmitt-enable = <0>;
		};
	};
	gpio26: gpio@26 {
		pins_cmd_dat {
			pins = <PINMUX_GPIO26__FUNC_CSI2_L2P_T1B>;
			slew-rate = <0>;
			bias-disable;
			bias-pull-down = <00>;
			output-low;
			input-schmitt-enable = <0>;
		};
	};
	gpio27: gpio@27 {
		pins_cmd_dat {
			pins = <PINMUX_GPIO27__FUNC_CSI2_L2N_T1C>;
			slew-rate = <0>;
			bias-disable;
			bias-pull-down = <00>;
			output-low;
			input-schmitt-enable = <0>;
		};
	};
	gpio28: gpio@28 {
		pins_cmd_dat {
			pins = <PINMUX_GPIO28__FUNC_GPIO28>;
			slew-rate = <1>;
			bias-disable;
			bias-pull-down = <00>;
			output-low;
			input-schmitt-enable = <1>;
		};
	};
	gpio29: gpio@29 {
		pins_cmd_dat {
			pins = <PINMUX_GPIO29__FUNC_GPIO29>;
			slew-rate = <1>;
			bias-disable;
			bias-pull-down = <00>;
			output-low;
			input-schmitt-enable = <1>;
		};
	};
	gpio30: gpio@30 {
		pins_cmd_dat {
			pins = <PINMUX_GPIO30__FUNC_CMMCLK0>;
			slew-rate = <0>;
			bias-disable;
			bias-pull-down = <00>;
			output-low;
			input-schmitt-enable = <1>;
		};
	};
	gpio31: gpio@31 {
		pins_cmd_dat {
			pins = <PINMUX_GPIO31__FUNC_CMMCLK1>;
			slew-rate = <0>;
			bias-disable;
			bias-pull-down = <00>;
			output-low;
			input-schmitt-enable = <1>;
		};
	};
	gpio32: gpio@32 {
		pins_cmd_dat {
			pins = <PINMUX_GPIO32__FUNC_GPIO32>;
			slew-rate = <1>;
			bias-disable;
			bias-pull-down = <00>;
			output-low;
			input-schmitt-enable = <1>;
		};
	};
	gpio33: gpio@33 {
		pins_cmd_dat {
			pins = <PINMUX_GPIO33__FUNC_GPIO33>;
			slew-rate = <1>;
			bias-disable;
			bias-pull-down = <00>;
			output-low;
			input-schmitt-enable = <1>;
		};
	};
	gpio34: gpio@34 {
		pins_cmd_dat {
			pins = <PINMUX_GPIO34__FUNC_GPIO34>;
			slew-rate = <1>;
			bias-disable;
			bias-pull-down = <00>;
			output-low;
			input-schmitt-enable = <1>;
		};
	};
	gpio35: gpio@35 {
		pins_cmd_dat {
			pins = <PINMUX_GPIO35__FUNC_GPIO35>;
			slew-rate = <1>;
			bias-disable;
			bias-pull-down = <00>;
			output-low;
			input-schmitt-enable = <1>;
		};
	};
	gpio36: gpio@36 {
		pins_cmd_dat {
			pins = <PINMUX_GPIO36__FUNC_CMMCLK2>;
			slew-rate = <1>;
			bias-disable;
			bias-pull-down = <00>;
			output-low;
			input-schmitt-enable = <1>;
		};
	};
	gpio37: gpio@37 {
		pins_cmd_dat {
			pins = <PINMUX_GPIO37__FUNC_SCL0_0>;
			slew-rate = <0>;
			bias-disable;
			bias-pull-down = <00>;
			output-low;
			input-schmitt-enable = <0>;
		};
	};
	gpio38: gpio@38 {
		pins_cmd_dat {
			pins = <PINMUX_GPIO38__FUNC_SDA0_0>;
			slew-rate = <0>;
			bias-disable;
			bias-pull-down = <00>;
			output-low;
			input-schmitt-enable = <0>;
		};
	};
	gpio39: gpio@39 {
		pins_cmd_dat {
			pins = <PINMUX_GPIO39__FUNC_GPIO39>;
			slew-rate = <1>;
			bias-disable;
			bias-pull-down = <00>;
			output-low;
			input-schmitt-enable = <0>;
		};
	};
	gpio40: gpio@40 {
		pins_cmd_dat {
			pins = <PINMUX_GPIO40__FUNC_GPIO40>;
			slew-rate = <1>;
			bias-disable;
			bias-pull-down = <00>;
			output-low;
			input-schmitt-enable = <0>;
		};
	};
	gpio41: gpio@41 {
		pins_cmd_dat {
			pins = <PINMUX_GPIO41__FUNC_GPIO41>;
			slew-rate = <1>;
			bias-disable;
			bias-pull-down = <00>;
			output-low;
			input-schmitt-enable = <0>;
		};
	};
	gpio42: gpio@42 {
		pins_cmd_dat {
			pins = <PINMUX_GPIO42__FUNC_GPIO42>;
			slew-rate = <1>;
			bias-disable;
			bias-pull-down = <00>;
			output-low;
			input-schmitt-enable = <0>;
		};
	};
	gpio43: gpio@43 {
		pins_cmd_dat {
			pins = <PINMUX_GPIO43__FUNC_GPIO43>;
			slew-rate = <1>;
			bias-disable;
			bias-pull-down = <00>;
			output-low;
			input-schmitt-enable = <0>;
		};
	};
	gpio44: gpio@44 {
		pins_cmd_dat {
			pins = <PINMUX_GPIO44__FUNC_GPIO44>;
			slew-rate = <1>;
			bias-disable;
			bias-pull-down = <00>;
			output-low;
			input-schmitt-enable = <0>;
		};
	};
	gpio45: gpio@45 {
		pins_cmd_dat {
			pins = <PINMUX_GPIO45__FUNC_GPIO45>;
			slew-rate = <1>;
			bias-disable;
			bias-pull-down = <00>;
			output-low;
			input-schmitt-enable = <0>;
		};
	};
	gpio46: gpio@46 {
		pins_cmd_dat {
			pins = <PINMUX_GPIO46__FUNC_GPIO46>;
			slew-rate = <1>;
			bias-disable;
			bias-pull-down = <00>;
			output-low;
			input-schmitt-enable = <0>;
		};
	};
	gpio47: gpio@47 {
		pins_cmd_dat {
			pins = <PINMUX_GPIO47__FUNC_GPIO47>;
			slew-rate = <1>;
			bias-disable;
			bias-pull-down = <00>;
			output-low;
			input-schmitt-enable = <0>;
		};
	};
	gpio48: gpio@48 {
		pins_cmd_dat {
			pins = <PINMUX_GPIO48__FUNC_GPIO48>;
			slew-rate = <1>;
			bias-disable;
			bias-pull-down = <00>;
			output-low;
			input-schmitt-enable = <0>;
		};
	};
	gpio49: gpio@49 {
		pins_cmd_dat {
			pins = <PINMUX_GPIO49__FUNC_GPIO49>;
			slew-rate = <1>;
			bias-disable;
			bias-pull-down = <00>;
			output-low;
			input-schmitt-enable = <0>;
		};
	};
	gpio50: gpio@50 {
		pins_cmd_dat {
			pins = <PINMUX_GPIO50__FUNC_GPIO50>;
			slew-rate = <1>;
			bias-disable;
			bias-pull-down = <00>;
			output-low;
			input-schmitt-enable = <0>;
		};
	};
	gpio51: gpio@51 {
		pins_cmd_dat {
			pins = <PINMUX_GPIO51__FUNC_GPIO51>;
			slew-rate = <1>;
			bias-disable;
			bias-pull-down = <00>;
			output-low;
			input-schmitt-enable = <0>;
		};
	};
	gpio52: gpio@52 {
		pins_cmd_dat {
			pins = <PINMUX_GPIO52__FUNC_GPIO52>;
			slew-rate = <1>;
			bias-disable;
			bias-pull-down = <00>;
			output-low;
			input-schmitt-enable = <0>;
		};
	};
	gpio53: gpio@53 {
		pins_cmd_dat {
			pins = <PINMUX_GPIO53__FUNC_GPIO53>;
			slew-rate = <1>;
			bias-disable;
			bias-pull-down = <00>;
			output-low;
			input-schmitt-enable = <0>;
		};
	};
	gpio54: gpio@54 {
		pins_cmd_dat {
			pins = <PINMUX_GPIO54__FUNC_GPIO54>;
			slew-rate = <1>;
			bias-disable;
			bias-pull-down = <00>;
			output-low;
			input-schmitt-enable = <0>;
		};
	};
	gpio55: gpio@55 {
		pins_cmd_dat {
			pins = <PINMUX_GPIO55__FUNC_SCL1_0>;
			slew-rate = <0>;
			bias-disable;
			bias-pull-down = <00>;
			output-low;
			input-schmitt-enable = <0>;
		};
	};
	gpio56: gpio@56 {
		pins_cmd_dat {
			pins = <PINMUX_GPIO56__FUNC_SDA1_0>;
			slew-rate = <0>;
			bias-disable;
			bias-pull-down = <00>;
			output-low;
			input-schmitt-enable = <0>;
		};
	};
	gpio57: gpio@57 {
		pins_cmd_dat {
			pins = <PINMUX_GPIO57__FUNC_GPIO57>;
			slew-rate = <1>;
			bias-disable;
			bias-pull-down = <00>;
			output-low;
			input-schmitt-enable = <0>;
		};
	};
	gpio58: gpio@58 {
		pins_cmd_dat {
			pins = <PINMUX_GPIO58__FUNC_GPIO58>;
			slew-rate = <1>;
			
			bias-pull-down = <00>;
			output-low;
			input-schmitt-enable = <0>;
		};
	};
	gpio59: gpio@59 {
		pins_cmd_dat {
			pins = <PINMUX_GPIO59__FUNC_GPIO59>;
			slew-rate = <1>;
			bias-disable;
			bias-pull-down = <00>;
			output-low;
			input-schmitt-enable = <0>;
		};
	};
	gpio60: gpio@60 {
		pins_cmd_dat {
			pins = <PINMUX_GPIO60__FUNC_GPIO60>;
			slew-rate = <1>;
			bias-disable;
			bias-pull-down = <00>;
			output-high;
			input-schmitt-enable = <0>;
		};
	};
	gpio61: gpio@61 {
		pins_cmd_dat {
			pins = <PINMUX_GPIO61__FUNC_EINT0>;
			slew-rate = <0>;
			
			bias-pull-down = <11>;
			output-low;
			input-schmitt-enable = <0>;
		};
	};
	gpio62: gpio@62 {
		pins_cmd_dat {
			pins = <PINMUX_GPIO62__FUNC_GPIO62>;
			slew-rate = <1>;
			bias-disable;
			bias-pull-down = <00>;
			output-high;
			input-schmitt-enable = <0>;
		};
	};
	gpio63: gpio@63 {
		pins_cmd_dat {
			pins = <PINMUX_GPIO63__FUNC_EINT2>;
			slew-rate = <0>;
			
			bias-pull-down = <00>;
			output-low;
			input-schmitt-enable = <1>;
		};
	};
	gpio64: gpio@64 {
		pins_cmd_dat {
			pins = <PINMUX_GPIO64__FUNC_EINT3>;
			slew-rate = <0>;
			
			bias-pull-down = <00>;
			output-low;
			input-schmitt-enable = <1>;
		};
	};
	gpio65: gpio@65 {
		pins_cmd_dat {
			pins = <PINMUX_GPIO65__FUNC_EINT4>;
			slew-rate = <1>;
			bias-disable;
			bias-pull-down = <00>;
			output-low;
			input-schmitt-enable = <1>;
		};
	};
	gpio66: gpio@66 {
		pins_cmd_dat {
			pins = <PINMUX_GPIO66__FUNC_EINT5>;
			slew-rate = <0>;
			
			bias-pull-down = <00>;
			output-low;
			input-schmitt-enable = <0>;
		};
	};
	gpio67: gpio@67 {
		pins_cmd_dat {
			pins = <PINMUX_GPIO67__FUNC_EINT6>;
			slew-rate = <0>;
			
			bias-pull-down = <11>;
			output-low;
			input-schmitt-enable = <0>;
		};
	};
	gpio68: gpio@68 {
		pins_cmd_dat {
			pins = <PINMUX_GPIO68__FUNC_GPIO68>;
			slew-rate = <1>;
			
			bias-pull-down = <00>;
			output-low;
			input-schmitt-enable = <1>;
		};
	};
	gpio69: gpio@69 {
		pins_cmd_dat {
			pins = <PINMUX_GPIO69__FUNC_I2S1_LRCK>;
			slew-rate = <1>;
			
			bias-pull-down = <00>;
			output-low;
			input-schmitt-enable = <1>;
		};
	};
	gpio70: gpio@70 {
		pins_cmd_dat {
			pins = <PINMUX_GPIO70__FUNC_I2S1_BCK>;
			slew-rate = <1>;
			
			bias-pull-down = <00>;
			output-low;
			input-schmitt-enable = <1>;
		};
	};
	gpio71: gpio@71 {
		pins_cmd_dat {
			pins = <PINMUX_GPIO71__FUNC_GPIO71>;
			slew-rate = <0>;
			
			bias-pull-down = <11>;
			output-low;
			input-schmitt-enable = <1>;
		};
	};
	gpio72: gpio@72 {
		pins_cmd_dat {
			pins = <PINMUX_GPIO72__FUNC_I2S2_DI>;
			slew-rate = <0>;
			
			bias-pull-down = <00>;
			output-low;
			input-schmitt-enable = <1>;
		};
	};
	gpio73: gpio@73 {
		pins_cmd_dat {
			pins = <PINMUX_GPIO73__FUNC_I2S1_DO>;
			slew-rate = <1>;
			
			bias-pull-down = <00>;
			output-low;
			input-schmitt-enable = <1>;
		};
	};
	gpio74: gpio@74 {
		pins_cmd_dat {
			pins = <PINMUX_GPIO74__FUNC_SCL3_0>;
			slew-rate = <0>;
			bias-disable;
			bias-pull-down = <00>;
			output-low;
			input-schmitt-enable = <0>;
		};
	};
	gpio75: gpio@75 {
		pins_cmd_dat {
			pins = <PINMUX_GPIO75__FUNC_SDA3_0>;
			slew-rate = <0>;
			bias-disable;
			bias-pull-down = <00>;
			output-low;
			input-schmitt-enable = <0>;
		};
	};
	gpio76: gpio@76 {
		pins_cmd_dat {
			pins = <PINMUX_GPIO76__FUNC_CONN_HRST_B>;
			slew-rate = <1>;
			
			bias-pull-down = <00>;
			output-low;
			input-schmitt-enable = <0>;
		};
	};
	gpio77: gpio@77 {
		pins_cmd_dat {
			pins = <PINMUX_GPIO77__FUNC_CONN_TOP_CLK>;
			slew-rate = <1>;
			bias-disable;
			bias-pull-down = <00>;
			output-low;
			input-schmitt-enable = <0>;
		};
	};
	gpio78: gpio@78 {
		pins_cmd_dat {
			pins = <PINMUX_GPIO78__FUNC_CONN_TOP_DATA>;
			slew-rate = <0>;
			
			bias-pull-down = <00>;
			output-low;
			input-schmitt-enable = <0>;
		};
	};
	gpio79: gpio@79 {
		pins_cmd_dat {
			pins = <PINMUX_GPIO79__FUNC_CONN_WB_PTA>;
			slew-rate = <0>;
			
			bias-pull-down = <00>;
			output-low;
			input-schmitt-enable = <0>;
		};
	};
	gpio80: gpio@80 {
		pins_cmd_dat {
			pins = <PINMUX_GPIO80__FUNC_CONN_WF_HB0>;
			slew-rate = <1>;
			bias-disable;
			bias-pull-down = <00>;
			output-low;
			input-schmitt-enable = <0>;
		};
	};
	gpio81: gpio@81 {
		pins_cmd_dat {
			pins = <PINMUX_GPIO81__FUNC_CONN_WF_HB1>;
			slew-rate = <1>;
			bias-disable;
			bias-pull-down = <00>;
			output-low;
			input-schmitt-enable = <0>;
		};
	};
	gpio82: gpio@82 {
		pins_cmd_dat {
			pins = <PINMUX_GPIO82__FUNC_CONN_WF_HB2>;
			slew-rate = <1>;
			bias-disable;
			bias-pull-down = <00>;
			output-low;
			input-schmitt-enable = <0>;
		};
	};
	gpio83: gpio@83 {
		pins_cmd_dat {
			pins = <PINMUX_GPIO83__FUNC_CONN_BT_CLK>;
			slew-rate = <1>;
			bias-disable;
			bias-pull-down = <00>;
			output-low;
			input-schmitt-enable = <0>;
		};
	};
	gpio84: gpio@84 {
		pins_cmd_dat {
			pins = <PINMUX_GPIO84__FUNC_CONN_BT_DATA>;
			slew-rate = <0>;
			
			bias-pull-down = <00>;
			output-low;
			input-schmitt-enable = <0>;
		};
	};
	gpio85: gpio@85 {
		pins_cmd_dat {
			pins = <PINMUX_GPIO85__FUNC_EINT8>;
			slew-rate = <0>;
			
			bias-pull-down = <11>;
			output-low;
			input-schmitt-enable = <1>;
		};
	};
	gpio86: gpio@86 {
		pins_cmd_dat {
			pins = <PINMUX_GPIO86__FUNC_EINT9>;
			slew-rate = <0>;
			
			bias-pull-down = <00>;
			output-low;
			input-schmitt-enable = <1>;
		};
	};
	gpio87: gpio@87 {
		pins_cmd_dat {
			pins = <PINMUX_GPIO87__FUNC_GPIO87>;
			slew-rate = <1>;
			bias-disable;
			bias-pull-down = <11>;
			output-low;
			input-schmitt-enable = <0>;
		};
	};
	gpio88: gpio@88 {
		pins_cmd_dat {
			pins = <PINMUX_GPIO88__FUNC_EINT11>;
			slew-rate = <0>;
			
			bias-pull-down = <11>;
			output-low;
			input-schmitt-enable = <0>;
		};
	};
	gpio89: gpio@89 {
		pins_cmd_dat {
			pins = <PINMUX_GPIO89__FUNC_GPIO89>;
			slew-rate = <1>;
			bias-disable;
			bias-pull-down = <00>;
			output-low;
			input-schmitt-enable = <0>;
		};
	};
	gpio90: gpio@90 {
		pins_cmd_dat {
			pins = <PINMUX_GPIO90__FUNC_GPIO90>;
			slew-rate = <1>;
			bias-disable;
			bias-pull-down = <00>;
			output-low;
			input-schmitt-enable = <0>;
		};
	};
	gpio91: gpio@91 {
		pins_cmd_dat {
			pins = <PINMUX_GPIO91__FUNC_GPIO91>;
			slew-rate = <1>;
			bias-disable;
			bias-pull-down = <00>;
			output-low;
			input-schmitt-enable = <0>;
		};
	};
	gpio92: gpio@92 {
		pins_cmd_dat {
			pins = <PINMUX_GPIO92__FUNC_EINT15>;
			slew-rate = <0>;
			
			bias-pull-down = <11>;
			output-low;
			input-schmitt-enable = <0>;
		};
	};
	gpio93: gpio@93 {
		pins_cmd_dat {
			pins = <PINMUX_GPIO93__FUNC_EINT16>;
			slew-rate = <0>;
			
			bias-pull-down = <11>;
			output-low;
			input-schmitt-enable = <0>;
		};
	};
	gpio94: gpio@94 {
		pins_cmd_dat {
			pins = <PINMUX_GPIO94__FUNC_USB_DRVVBUS>;
			slew-rate = <0>;
			bias-disable;
			bias-pull-down = <00>;
			output-low;
			input-schmitt-enable = <0>;
		};
	};
	gpio95: gpio@95 {
		pins_cmd_dat {
			pins = <PINMUX_GPIO95__FUNC_SDA2_0>;
			slew-rate = <0>;
			bias-disable;
			bias-pull-down = <00>;
			output-low;
			input-schmitt-enable = <0>;
		};
	};
	gpio96: gpio@96 {
		pins_cmd_dat {
			pins = <PINMUX_GPIO96__FUNC_SCL2_0>;
			slew-rate = <0>;
			bias-disable;
			bias-pull-down = <00>;
			output-low;
			input-schmitt-enable = <0>;
		};
	};
	gpio97: gpio@97 {
		pins_cmd_dat {
			pins = <PINMUX_GPIO97__FUNC_URXD0>;
			slew-rate = <0>;
			
			bias-pull-down = <11>;
			output-low;
			input-schmitt-enable = <0>;
		};
	};
	gpio98: gpio@98 {
		pins_cmd_dat {
			pins = <PINMUX_GPIO98__FUNC_UTXD0>;
			slew-rate = <1>;
			
			bias-pull-down = <00>;
			output-low;
			input-schmitt-enable = <0>;
		};
	};
	gpio99: gpio@99 {
		pins_cmd_dat {
			pins = <PINMUX_GPIO99__FUNC_RTC32K_CK>;
			slew-rate = <0>;
			bias-disable;
			bias-pull-down = <00>;
			output-low;
			input-schmitt-enable = <0>;
		};
	};
	gpio100: gpio@100 {
		pins_cmd_dat {
			pins = <PINMUX_GPIO100__FUNC_SRCLKENAI0>;
			slew-rate = <0>;
			
			bias-pull-down = <00>;
			output-low;
			input-schmitt-enable = <0>;
		};
	};
	gpio101: gpio@101 {
		pins_cmd_dat {
			pins = <PINMUX_GPIO101__FUNC_GPIO101>;
			slew-rate = <0>;
			
			bias-pull-down = <00>;
			output-low;
			input-schmitt-enable = <0>;
		};
	};
	gpio102: gpio@102 {
		pins_cmd_dat {
			pins = <PINMUX_GPIO102__FUNC_SRCLKENA0>;
			slew-rate = <1>;
			bias-disable;
			bias-pull-down = <00>;
			output-high;
			input-schmitt-enable = <0>;
		};
	};
	gpio103: gpio@103 {
		pins_cmd_dat {
			pins = <PINMUX_GPIO103__FUNC_SRCLKENA1>;
			slew-rate = <1>;
			bias-disable;
			bias-pull-down = <00>;
			output-high;
			input-schmitt-enable = <0>;
		};
	};
	gpio104: gpio@104 {
		pins_cmd_dat {
			pins = <PINMUX_GPIO104__FUNC_SYSRSTB>;
			slew-rate = <0>;
			
			bias-pull-down = <11>;
			output-low;
			input-schmitt-enable = <0>;
		};
	};
	gpio105: gpio@105 {
		pins_cmd_dat {
			pins = <PINMUX_GPIO105__FUNC_WATCHDOG>;
			slew-rate = <0>;
			bias-disable;
			bias-pull-down = <00>;
			output-low;
			input-schmitt-enable = <0>;
		};
	};
	gpio106: gpio@106 {
		pins_cmd_dat {
			pins = <PINMUX_GPIO106__FUNC_KPROW0>;
			slew-rate = <1>;
			bias-disable;
			bias-pull-down = <00>;
			output-low;
			input-schmitt-enable = <0>;
		};
	};
	gpio107: gpio@107 {
		pins_cmd_dat {
			pins = <PINMUX_GPIO107__FUNC_DAP_SIB1_SWD>;
			slew-rate = <0>;
			bias-disable;
			bias-pull-down = <00>;
			output-low;
			input-schmitt-enable = <0>;
		};
	};
	gpio108: gpio@108 {
		pins_cmd_dat {
			pins = <PINMUX_GPIO108__FUNC_GPIO108>;
			slew-rate = <1>;
			bias-disable;
			bias-pull-down = <00>;
			output-low;
			input-schmitt-enable = <0>;
		};
	};
	gpio109: gpio@109 {
		pins_cmd_dat {
			pins = <PINMUX_GPIO109__FUNC_KPCOL0>;
			slew-rate = <0>;
			
			bias-pull-down = <11>;
			output-low;
			input-schmitt-enable = <1>;
		};
	};
	gpio110: gpio@110 {
		pins_cmd_dat {
			pins = <PINMUX_GPIO110__FUNC_GPIO110>;
			slew-rate = <1>;
			bias-disable;
			bias-pull-down = <00>;
			output-low;
			input-schmitt-enable = <0>;
		};
	};
	gpio111: gpio@111 {
		pins_cmd_dat {
			pins = <PINMUX_GPIO111__FUNC_GPIO111>;
			slew-rate = <1>;
			bias-disable;
			bias-pull-down = <00>;
			output-low;
			input-schmitt-enable = <0>;
		};
	};
	gpio112: gpio@112 {
		pins_cmd_dat {
			pins = <PINMUX_GPIO112__FUNC_MD_INT1_C2K_UIM1_HOT_PLUG_IN>;
			slew-rate = <0>;
			
			bias-pull-down = <11>;
			output-low;
			input-schmitt-enable = <1>;
		};
	};
	gpio113: gpio@113 {
		pins_cmd_dat {
			pins = <PINMUX_GPIO113__FUNC_MD_INT0_C2K_UIM0_HOT_PLUG_IN>;
			slew-rate = <0>;
			
			bias-pull-down = <11>;
			output-low;
			input-schmitt-enable = <1>;
		};
	};
	gpio114: gpio@114 {
		pins_cmd_dat {
			pins = <PINMUX_GPIO114__FUNC_MSDC0_DAT0>;
			slew-rate = <0>;
			
			bias-pull-down = <11>;
			output-low;
			input-schmitt-enable = <1>;
		};
	};
	gpio115: gpio@115 {
		pins_cmd_dat {
			pins = <PINMUX_GPIO115__FUNC_MSDC0_DAT1>;
			slew-rate = <0>;
			
			bias-pull-down = <11>;
			output-low;
			input-schmitt-enable = <1>;
		};
	};
	gpio116: gpio@116 {
		pins_cmd_dat {
			pins = <PINMUX_GPIO116__FUNC_MSDC0_DAT2>;
			slew-rate = <0>;
			
			bias-pull-down = <11>;
			output-low;
			input-schmitt-enable = <1>;
		};
	};
	gpio117: gpio@117 {
		pins_cmd_dat {
			pins = <PINMUX_GPIO117__FUNC_MSDC0_DAT3>;
			slew-rate = <0>;
			
			bias-pull-down = <11>;
			output-low;
			input-schmitt-enable = <1>;
		};
	};
	gpio118: gpio@118 {
		pins_cmd_dat {
			pins = <PINMUX_GPIO118__FUNC_MSDC0_DAT4>;
			slew-rate = <0>;
			
			bias-pull-down = <11>;
			output-low;
			input-schmitt-enable = <1>;
		};
	};
	gpio119: gpio@119 {
		pins_cmd_dat {
			pins = <PINMUX_GPIO119__FUNC_MSDC0_DAT5>;
			slew-rate = <0>;
			
			bias-pull-down = <11>;
			output-low;
			input-schmitt-enable = <1>;
		};
	};
	gpio120: gpio@120 {
		pins_cmd_dat {
			pins = <PINMUX_GPIO120__FUNC_MSDC0_DAT6>;
			slew-rate = <0>;
			
			bias-pull-down = <11>;
			output-low;
			input-schmitt-enable = <1>;
		};
	};
	gpio121: gpio@121 {
		pins_cmd_dat {
			pins = <PINMUX_GPIO121__FUNC_MSDC0_DAT7>;
			slew-rate = <0>;
			
			bias-pull-down = <11>;
			output-low;
			input-schmitt-enable = <1>;
		};
	};
	gpio122: gpio@122 {
		pins_cmd_dat {
			pins = <PINMUX_GPIO122__FUNC_MSDC0_CMD>;
			slew-rate = <0>;
			
			bias-pull-down = <11>;
			output-low;
			input-schmitt-enable = <1>;
		};
	};
	gpio123: gpio@123 {
		pins_cmd_dat {
			pins = <PINMUX_GPIO123__FUNC_MSDC0_CLK>;
			slew-rate = <1>;
			bias-disable;
			bias-pull-down = <00>;
			output-low;
			input-schmitt-enable = <1>;
		};
	};
	gpio124: gpio@124 {
		pins_cmd_dat {
			pins = <PINMUX_GPIO124__FUNC_MSDC0_DSL>;
			slew-rate = <0>;
			bias-disable;
			bias-pull-down = <00>;
			output-low;
			input-schmitt-enable = <1>;
		};
	};
	gpio125: gpio@125 {
		pins_cmd_dat {
			pins = <PINMUX_GPIO125__FUNC_MSDC0_RSTB>;
			slew-rate = <1>;
			bias-disable;
			bias-pull-down = <00>;
			output-high;
			input-schmitt-enable = <1>;
		};
	};
	gpio126: gpio@126 {
		pins_cmd_dat {
			pins = <PINMUX_GPIO126__FUNC_MD1_SIM1_SCLK>;
			slew-rate = <1>;
			bias-disable;
			bias-pull-down = <00>;
			output-low;
			input-schmitt-enable = <1>;
		};
	};
	gpio127: gpio@127 {
		pins_cmd_dat {
			pins = <PINMUX_GPIO127__FUNC_MD1_SIM1_SRST>;
			slew-rate = <1>;
			bias-disable;
			bias-pull-down = <00>;
			output-low;
			input-schmitt-enable = <1>;
		};
	};
	gpio128: gpio@128 {
		pins_cmd_dat {
			pins = <PINMUX_GPIO128__FUNC_MD1_SIM1_SIO>;
			slew-rate = <0>;
			
			bias-pull-down = <11>;
			output-low;
			input-schmitt-enable = <1>;
		};
	};
	gpio129: gpio@129 {
		pins_cmd_dat {
			pins = <PINMUX_GPIO129__FUNC_MSDC1_CMD>;
			slew-rate = <0>;
			bias-disable;
			bias-pull-down = <00>;
			output-low;
			input-schmitt-enable = <1>;
		};
	};
	gpio130: gpio@130 {
		pins_cmd_dat {
			pins = <PINMUX_GPIO130__FUNC_MSDC1_DAT0>;
			slew-rate = <0>;
			
			bias-pull-down = <11>;
			output-low;
			input-schmitt-enable = <1>;
		};
	};
	gpio131: gpio@131 {
		pins_cmd_dat {
			pins = <PINMUX_GPIO131__FUNC_MSDC1_DAT1>;
			slew-rate = <0>;
			
			bias-pull-down = <11>;
			output-low;
			input-schmitt-enable = <1>;
		};
	};
	gpio132: gpio@132 {
		pins_cmd_dat {
			pins = <PINMUX_GPIO132__FUNC_MSDC1_DAT2>;
			slew-rate = <0>;
			
			bias-pull-down = <11>;
			output-low;
			input-schmitt-enable = <1>;
		};
	};
	gpio133: gpio@133 {
		pins_cmd_dat {
			pins = <PINMUX_GPIO133__FUNC_MSDC1_DAT3>;
			slew-rate = <0>;
			
			bias-pull-down = <11>;
			output-low;
			input-schmitt-enable = <1>;
		};
	};
	gpio134: gpio@134 {
		pins_cmd_dat {
			pins = <PINMUX_GPIO134__FUNC_MSDC1_CLK>;
			slew-rate = <1>;
			bias-disable;
			bias-pull-down = <00>;
			output-low;
			input-schmitt-enable = <1>;
		};
	};
	gpio135: gpio@135 {
		pins_cmd_dat {
			pins = <PINMUX_GPIO135__FUNC_TDM_LRCK>;
			slew-rate = <1>;
			bias-disable;
			bias-pull-down = <00>;
			output-low;
			input-schmitt-enable = <0>;
		};
	};
	gpio136: gpio@136 {
		pins_cmd_dat {
			pins = <PINMUX_GPIO136__FUNC_TDM_BCK>;
			slew-rate = <1>;
			bias-disable;
			bias-pull-down = <00>;
			output-low;
			input-schmitt-enable = <0>;
		};
	};
	gpio137: gpio@137 {
		pins_cmd_dat {
			pins = <PINMUX_GPIO137__FUNC_IRTX_OUT>;
			slew-rate = <1>;
			bias-disable;
			bias-pull-down = <00>;
			output-low;
			input-schmitt-enable = <1>;
		};
	};
	gpio138: gpio@138 {
		pins_cmd_dat {
			pins = <PINMUX_GPIO138__FUNC_TDM_DATA0>;
			slew-rate = <1>;
			bias-disable;
			bias-pull-down = <00>;
			output-low;
			input-schmitt-enable = <1>;
		};
	};
	gpio139: gpio@139 {
		pins_cmd_dat {
			pins = <PINMUX_GPIO139__FUNC_GPIO139>;
			slew-rate = <1>;
			bias-disable;
			bias-pull-down = <00>;
			output-high;
			input-schmitt-enable = <0>;
		};
	};
	gpio140: gpio@140 {
		pins_cmd_dat {
			pins = <PINMUX_GPIO140__FUNC_GPIO140>;
			slew-rate = <0>;
			bias-disable;
			bias-pull-down = <00>;
			output-low;
			input-schmitt-enable = <0>;
		};
	};
	gpio141: gpio@141 {
		pins_cmd_dat {
			pins = <PINMUX_GPIO141__FUNC_GPIO141>;
			slew-rate = <1>;
			bias-disable;
			bias-pull-down = <00>;
			output-low;
			input-schmitt-enable = <1>;
		};
	};
	gpio142: gpio@142 {
		pins_cmd_dat {
			pins = <PINMUX_GPIO142__FUNC_PWRAP_SPI0_MI>;
			slew-rate = <0>;
			
			bias-pull-down = <00>;
			output-low;
			input-schmitt-enable = <1>;
		};
	};
	gpio143: gpio@143 {
		pins_cmd_dat {
			pins = <PINMUX_GPIO143__FUNC_PWRAP_SPI0_MO>;
			slew-rate = <0>;
			
			bias-pull-down = <00>;
			output-low;
			input-schmitt-enable = <1>;
		};
	};
	gpio144: gpio@144 {
		pins_cmd_dat {
			pins = <PINMUX_GPIO144__FUNC_PWRAP_SPI0_CK>;
			slew-rate = <1>;
			bias-disable;
			bias-pull-down = <00>;
			output-low;
			input-schmitt-enable = <1>;
		};
	};
	gpio145: gpio@145 {
		pins_cmd_dat {
			pins = <PINMUX_GPIO145__FUNC_PWRAP_SPI0_CSN>;
			slew-rate = <1>;
			bias-disable;
			bias-pull-down = <00>;
			output-low;
			input-schmitt-enable = <1>;
		};
	};
	gpio146: gpio@146 {
		pins_cmd_dat {
			pins = <PINMUX_GPIO146__FUNC_AUD_CLK_MOSI>;
			slew-rate = <1>;
			
			bias-pull-down = <00>;
			output-low;
			input-schmitt-enable = <1>;
		};
	};
	gpio147: gpio@147 {
		pins_cmd_dat {
			pins = <PINMUX_GPIO147__FUNC_AUD_DAT_MISO>;
			slew-rate = <0>;
			
			bias-pull-down = <00>;
			output-low;
			input-schmitt-enable = <1>;
		};
	};
	gpio148: gpio@148 {
		pins_cmd_dat {
			pins = <PINMUX_GPIO148__FUNC_AUD_DAT_MOSI>;
			slew-rate = <1>;
			
			bias-pull-down = <00>;
			output-low;
			input-schmitt-enable = <1>;
		};
	};
	gpio149: gpio@149 {
		pins_cmd_dat {
			pins = <PINMUX_GPIO149__FUNC_VOW_CLK_MISO>;
			slew-rate = <0>;
			
			bias-pull-down = <00>;
			output-low;
			input-schmitt-enable = <1>;
		};
	};
	gpio150: gpio@150 {
		pins_cmd_dat {
			pins = <PINMUX_GPIO150__FUNC_ANC_DAT_MOSI>;
			slew-rate = <1>;
			
			bias-pull-down = <00>;
			output-low;
			input-schmitt-enable = <0>;
		};
	};
	gpio151: gpio@151 {
		pins_cmd_dat {
			pins = <PINMUX_GPIO151__FUNC_SCL6_0>;
			slew-rate = <0>;
			bias-disable;
			bias-pull-down = <00>;
			output-low;
			input-schmitt-enable = <0>;
		};
	};
	gpio152: gpio@152 {
		pins_cmd_dat {
			pins = <PINMUX_GPIO152__FUNC_SDA6_0>;
			slew-rate = <0>;
			bias-disable;
			bias-pull-down = <00>;
			output-low;
			input-schmitt-enable = <0>;
		};
	};
	gpio153: gpio@153 {
		pins_cmd_dat {
			pins = <PINMUX_GPIO153__FUNC_SCL7_0>;
			slew-rate = <0>;
			bias-disable;
			bias-pull-down = <00>;
			output-low;
			input-schmitt-enable = <0>;
		};
	};
	gpio154: gpio@154 {
		pins_cmd_dat {
			pins = <PINMUX_GPIO154__FUNC_SDA7_0>;
			slew-rate = <0>;
			bias-disable;
			bias-pull-down = <00>;
			output-low;
			input-schmitt-enable = <0>;
		};
	};
	gpio155: gpio@155 {
		pins_cmd_dat {
			pins = <PINMUX_GPIO155__FUNC_MD1_SIM2_SCLK>;
			slew-rate = <1>;
			bias-disable;
			bias-pull-down = <00>;
			output-low;
			input-schmitt-enable = <1>;
		};
	};
	gpio156: gpio@156 {
		pins_cmd_dat {
			pins = <PINMUX_GPIO156__FUNC_MD1_SIM2_SRST>;
			slew-rate = <1>;
			bias-disable;
			bias-pull-down = <00>;
			output-low;
			input-schmitt-enable = <1>;
		};
	};
	gpio157: gpio@157 {
		pins_cmd_dat {
			pins = <PINMUX_GPIO157__FUNC_MD1_SIM2_SIO>;
			slew-rate = <0>;
			
			bias-pull-down = <11>;
			output-low;
			input-schmitt-enable = <1>;
		};
	};
	gpio158: gpio@158 {
		pins_cmd_dat {
			pins = <PINMUX_GPIO158__FUNC_MIPI_TDP0>;
			slew-rate = <0>;
			
			bias-pull-down = <00>;
			output-low;
			input-schmitt-enable = <0>;
		};
	};
	gpio159: gpio@159 {
		pins_cmd_dat {
			pins = <PINMUX_GPIO159__FUNC_MIPI_TDN0>;
			slew-rate = <0>;
			
			bias-pull-down = <00>;
			output-low;
			input-schmitt-enable = <0>;
		};
	};
	gpio160: gpio@160 {
		pins_cmd_dat {
			pins = <PINMUX_GPIO160__FUNC_MIPI_TDP1>;
			slew-rate = <0>;
			
			bias-pull-down = <00>;
			output-low;
			input-schmitt-enable = <0>;
		};
	};
	gpio161: gpio@161 {
		pins_cmd_dat {
			pins = <PINMUX_GPIO161__FUNC_MIPI_TDN1>;
			slew-rate = <0>;
			
			bias-pull-down = <00>;
			output-low;
			input-schmitt-enable = <0>;
		};
	};
	gpio162: gpio@162 {
		pins_cmd_dat {
			pins = <PINMUX_GPIO162__FUNC_MIPI_TCP>;
			slew-rate = <0>;
			
			bias-pull-down = <00>;
			output-low;
			input-schmitt-enable = <0>;
		};
	};
	gpio163: gpio@163 {
		pins_cmd_dat {
			pins = <PINMUX_GPIO163__FUNC_MIPI_TCN>;
			slew-rate = <0>;
			
			bias-pull-down = <00>;
			output-low;
			input-schmitt-enable = <0>;
		};
	};
	gpio164: gpio@164 {
		pins_cmd_dat {
			pins = <PINMUX_GPIO164__FUNC_MIPI_TDP2>;
			slew-rate = <0>;
			
			bias-pull-down = <00>;
			output-low;
			input-schmitt-enable = <0>;
		};
	};
	gpio165: gpio@165 {
		pins_cmd_dat {
			pins = <PINMUX_GPIO165__FUNC_MIPI_TDN2>;
			slew-rate = <0>;
			
			bias-pull-down = <00>;
			output-low;
			input-schmitt-enable = <0>;
		};
	};
	gpio166: gpio@166 {
		pins_cmd_dat {
			pins = <PINMUX_GPIO166__FUNC_MIPI_TDP3>;
			slew-rate = <0>;
			
			bias-pull-down = <00>;
			output-low;
			input-schmitt-enable = <0>;
		};
	};
	gpio167: gpio@167 {
		pins_cmd_dat {
			pins = <PINMUX_GPIO167__FUNC_MIPI_TDN3>;
			slew-rate = <0>;
			
			bias-pull-down = <00>;
			output-low;
			input-schmitt-enable = <0>;
		};
	};
	gpio168: gpio@168 {
		pins_cmd_dat {
			pins = <PINMUX_GPIO168__FUNC_MIPI_TDP0_A>;
			slew-rate = <0>;
			
			bias-pull-down = <00>;
			output-low;
			input-schmitt-enable = <0>;
		};
	};
	gpio169: gpio@169 {
		pins_cmd_dat {
			pins = <PINMUX_GPIO169__FUNC_MIPI_TDN0_A>;
			slew-rate = <0>;
			
			bias-pull-down = <00>;
			output-low;
			input-schmitt-enable = <0>;
		};
	};
	gpio170: gpio@170 {
		pins_cmd_dat {
			pins = <PINMUX_GPIO170__FUNC_MIPI_TDP1_A>;
			slew-rate = <0>;
			
			bias-pull-down = <00>;
			output-low;
			input-schmitt-enable = <0>;
		};
	};
	gpio171: gpio@171 {
		pins_cmd_dat {
			pins = <PINMUX_GPIO171__FUNC_MIPI_TDN1_A>;
			slew-rate = <0>;
			
			bias-pull-down = <00>;
			output-low;
			input-schmitt-enable = <0>;
		};
	};
	gpio172: gpio@172 {
		pins_cmd_dat {
			pins = <PINMUX_GPIO172__FUNC_MIPI_TCP_A>;
			slew-rate = <0>;
			
			bias-pull-down = <00>;
			output-low;
			input-schmitt-enable = <0>;
		};
	};
	gpio173: gpio@173 {
		pins_cmd_dat {
			pins = <PINMUX_GPIO173__FUNC_MIPI_TCN_A>;
			slew-rate = <0>;
			
			bias-pull-down = <00>;
			output-low;
			input-schmitt-enable = <0>;
		};
	};
	gpio174: gpio@174 {
		pins_cmd_dat {
			pins = <PINMUX_GPIO174__FUNC_MIPI_TDP2_A>;
			slew-rate = <0>;
			
			bias-pull-down = <00>;
			output-low;
			input-schmitt-enable = <0>;
		};
	};
	gpio175: gpio@175 {
		pins_cmd_dat {
			pins = <PINMUX_GPIO175__FUNC_MIPI_TDN2_A>;
			slew-rate = <0>;
			
			bias-pull-down = <00>;
			output-low;
			input-schmitt-enable = <0>;
		};
	};
	gpio176: gpio@176 {
		pins_cmd_dat {
			pins = <PINMUX_GPIO176__FUNC_MIPI_TDP3_A>;
			slew-rate = <0>;
			
			bias-pull-down = <00>;
			output-low;
			input-schmitt-enable = <0>;
		};
	};
	gpio177: gpio@177 {
		pins_cmd_dat {
			pins = <PINMUX_GPIO177__FUNC_MIPI_TDN3_A>;
			slew-rate = <0>;
			
			bias-pull-down = <00>;
			output-low;
			input-schmitt-enable = <0>;
		};
	};
	gpio178: gpio@178 {
		pins_cmd_dat {
			pins = <PINMUX_GPIO178__FUNC_DISP_PWM>;
			slew-rate = <1>;
			bias-disable;
			bias-pull-down = <00>;
			output-low;
			input-schmitt-enable = <0>;
		};
	};
	gpio179: gpio@179 {
		pins_cmd_dat {
			pins = <PINMUX_GPIO179__FUNC_DSI_TE0>;
			slew-rate = <0>;
			
			bias-pull-down = <00>;
			output-low;
			input-schmitt-enable = <0>;
		};
	};
	gpio180: gpio@180 {
		pins_cmd_dat {
			pins = <PINMUX_GPIO180__FUNC_GPIO180>;
			slew-rate = <1>;
			
			bias-pull-down = <00>;
			output-low;
			input-schmitt-enable = <0>;
		};
	};
	gpio181: gpio@181 {
		pins_cmd_dat {
			pins = <PINMUX_GPIO181__FUNC_IDDIG>;
			slew-rate = <0>;
			bias-disable;
			bias-pull-down = <00>;
			output-low;
			input-schmitt-enable = <0>;
		};
	};
	gpio182: gpio@182 {
		pins_cmd_dat {
			pins = <PINMUX_GPIO182__FUNC_TESTMODE>;
			slew-rate = <0>;
			bias-disable;
			bias-pull-down = <00>;
			output-low;
			input-schmitt-enable = <0>;
		};
	};
	gpio183: gpio@183 {
		pins_cmd_dat {
			pins = <PINMUX_GPIO183__FUNC_RFIC0_BSI_CK>;
			slew-rate = <1>;
			bias-disable;
			bias-pull-down = <00>;
			output-low;
			input-schmitt-enable = <0>;
		};
	};
	gpio184: gpio@184 {
		pins_cmd_dat {
			pins = <PINMUX_GPIO184__FUNC_RFIC0_BSI_EN>;
			slew-rate = <1>;
			bias-disable;
			bias-pull-down = <00>;
			output-low;
			input-schmitt-enable = <0>;
		};
	};
	gpio185: gpio@185 {
		pins_cmd_dat {
			pins = <PINMUX_GPIO185__FUNC_RFIC0_BSI_D0>;
			slew-rate = <1>;
			bias-disable;
			bias-pull-down = <00>;
			output-low;
			input-schmitt-enable = <0>;
		};
	};
	gpio186: gpio@186 {
		pins_cmd_dat {
			pins = <PINMUX_GPIO186__FUNC_RFIC0_BSI_D1>;
			slew-rate = <1>;
			bias-disable;
			bias-pull-down = <00>;
			output-low;
			input-schmitt-enable = <0>;
		};
	};
	gpio187: gpio@187 {
		pins_cmd_dat {
			pins = <PINMUX_GPIO187__FUNC_RFIC0_BSI_D2>;
			slew-rate = <1>;
			bias-disable;
			bias-pull-down = <00>;
			output-low;
			input-schmitt-enable = <0>;
		};
	};
	gpio188: gpio@188 {
		pins_cmd_dat {
			pins = <PINMUX_GPIO188__FUNC_MIPI0_SCLK>;
			slew-rate = <1>;
			bias-disable;
			bias-pull-down = <00>;
			output-low;
			input-schmitt-enable = <0>;
		};
	};
	gpio189: gpio@189 {
		pins_cmd_dat {
			pins = <PINMUX_GPIO189__FUNC_MIPI0_SDATA>;
			slew-rate = <1>;
			bias-disable;
			bias-pull-down = <00>;
			output-low;
			input-schmitt-enable = <0>;
		};
	};
	gpio190: gpio@190 {
		pins_cmd_dat {
			pins = <PINMUX_GPIO190__FUNC_MIPI1_SCLK>;
			slew-rate = <1>;
			bias-disable;
			bias-pull-down = <00>;
			output-low;
			input-schmitt-enable = <0>;
		};
	};
	gpio191: gpio@191 {
		pins_cmd_dat {
			pins = <PINMUX_GPIO191__FUNC_MIPI1_SDATA>;
			slew-rate = <1>;
			bias-disable;
			bias-pull-down = <00>;
			output-low;
			input-schmitt-enable = <0>;
		};
	};
	gpio192: gpio@192 {
		pins_cmd_dat {
			pins = <PINMUX_GPIO192__FUNC_BPI_BUS4>;
			slew-rate = <1>;
			bias-disable;
			bias-pull-down = <00>;
			output-low;
			input-schmitt-enable = <0>;
		};
	};
	gpio193: gpio@193 {
		pins_cmd_dat {
			pins = <PINMUX_GPIO193__FUNC_BPI_BUS5>;
			slew-rate = <1>;
			bias-disable;
			bias-pull-down = <00>;
			output-low;
			input-schmitt-enable = <0>;
		};
	};
	gpio194: gpio@194 {
		pins_cmd_dat {
			pins = <PINMUX_GPIO194__FUNC_GPIO194>;
			slew-rate = <0>;
			bias-disable;
			bias-pull-down = <00>;
			output-low;
			input-schmitt-enable = <0>;
		};
	};
	gpio195: gpio@195 {
		pins_cmd_dat {
			pins = <PINMUX_GPIO195__FUNC_GPIO195>;
			slew-rate = <0>;
			bias-disable;
			bias-pull-down = <00>;
			output-low;
			input-schmitt-enable = <0>;
		};
	};
	gpio196: gpio@196 {
		pins_cmd_dat {
			pins = <PINMUX_GPIO196__FUNC_GPIO196>;
			slew-rate = <1>;
			bias-disable;
			bias-pull-down = <00>;
			output-low;
			input-schmitt-enable = <0>;
		};
	};
	gpio197: gpio@197 {
		pins_cmd_dat {
			pins = <PINMUX_GPIO197__FUNC_GPIO197>;
			slew-rate = <1>;
			bias-disable;
			bias-pull-down = <00>;
			output-low;
			input-schmitt-enable = <0>;
		};
	};
	gpio198: gpio@198 {
		pins_cmd_dat {
			pins = <PINMUX_GPIO198__FUNC_BPI_BUS10>;
			slew-rate = <1>;
			bias-disable;
			bias-pull-down = <00>;
			output-low;
			input-schmitt-enable = <0>;
		};
	};
	gpio199: gpio@199 {
		pins_cmd_dat {
			pins = <PINMUX_GPIO199__FUNC_BPI_BUS11>;
			slew-rate = <1>;
			bias-disable;
			bias-pull-down = <00>;
			output-low;
			input-schmitt-enable = <0>;
		};
	};
	gpio200: gpio@200 {
		pins_cmd_dat {
			pins = <PINMUX_GPIO200__FUNC_BPI_BUS12>;
			slew-rate = <1>;
			bias-disable;
			bias-pull-down = <00>;
			output-low;
			input-schmitt-enable = <0>;
		};
	};
	gpio201: gpio@201 {
		pins_cmd_dat {
			pins = <PINMUX_GPIO201__FUNC_BPI_BUS13>;
			slew-rate = <1>;
			bias-disable;
			bias-pull-down = <00>;
			output-low;
			input-schmitt-enable = <0>;
		};
	};
	gpio202: gpio@202 {
		pins_cmd_dat {
			pins = <PINMUX_GPIO202__FUNC_BPI_BUS14>;
			slew-rate = <1>;
			bias-disable;
			bias-pull-down = <00>;
			output-low;
			input-schmitt-enable = <0>;
		};
	};
	gpio203: gpio@203 {
		pins_cmd_dat {
			pins = <PINMUX_GPIO203__FUNC_BPI_BUS15>;
			slew-rate = <1>;
			bias-disable;
			bias-pull-down = <00>;
			output-low;
			input-schmitt-enable = <0>;
		};
	};
	gpio204: gpio@204 {
		pins_cmd_dat {
			pins = <PINMUX_GPIO204__FUNC_PA_VM0>;
			slew-rate = <1>;
			bias-disable;
			bias-pull-down = <00>;
			output-low;
			input-schmitt-enable = <0>;
		};
	};
	gpio205: gpio@205 {
		pins_cmd_dat {
			pins = <PINMUX_GPIO205__FUNC_PA_VM1>;
			slew-rate = <1>;
			bias-disable;
			bias-pull-down = <00>;
			output-low;
			input-schmitt-enable = <0>;
		};
	};
	gpio206: gpio@206 {
		pins_cmd_dat {
			pins = <PINMUX_GPIO206__FUNC_BPI_BUS18>;
			slew-rate = <1>;
			bias-disable;
			bias-pull-down = <00>;
			output-low;
			input-schmitt-enable = <0>;
		};
	};
	gpio207: gpio@207 {
		pins_cmd_dat {
			pins = <PINMUX_GPIO207__FUNC_BPI_BUS19>;
			slew-rate = <1>;
			bias-disable;
			bias-pull-down = <00>;
			output-low;
			input-schmitt-enable = <0>;
		};
	};
	gpio208: gpio@208 {
		pins_cmd_dat {
			pins = <PINMUX_GPIO208__FUNC_BPI_BUS20>;
			slew-rate = <1>;
			bias-disable;
			bias-pull-down = <00>;
			output-low;
			input-schmitt-enable = <0>;
		};
	};
	gpio209: gpio@209 {
		pins_cmd_dat {
			pins = <PINMUX_GPIO209__FUNC_BPI_BUS21>;
			slew-rate = <1>;
			bias-disable;
			bias-pull-down = <00>;
			output-low;
			input-schmitt-enable = <0>;
		};
	};
	gpio210: gpio@210 {
		pins_cmd_dat {
			pins = <PINMUX_GPIO210__FUNC_DET_BPI0>;
			slew-rate = <1>;
			bias-disable;
			bias-pull-down = <00>;
			output-low;
			input-schmitt-enable = <0>;
		};
	};
	gpio211: gpio@211 {
		pins_cmd_dat {
			pins = <PINMUX_GPIO211__FUNC_DET_BPI1>;
			slew-rate = <1>;
			bias-disable;
			bias-pull-down = <00>;
			output-low;
			input-schmitt-enable = <0>;
		};
	};
	gpio212: gpio@212 {
		pins_cmd_dat {
			pins = <PINMUX_GPIO212__FUNC_BPI_BUS0>;
			slew-rate = <1>;
			bias-disable;
			bias-pull-down = <00>;
			output-low;
			input-schmitt-enable = <0>;
		};
	};
	gpio213: gpio@213 {
		pins_cmd_dat {
			pins = <PINMUX_GPIO213__FUNC_BPI_BUS1>;
			slew-rate = <1>;
			bias-disable;
			bias-pull-down = <00>;
			output-low;
			input-schmitt-enable = <0>;
		};
	};
	gpio214: gpio@214 {
		pins_cmd_dat {
			pins = <PINMUX_GPIO214__FUNC_BPI_BUS2>;
			slew-rate = <1>;
			bias-disable;
			bias-pull-down = <00>;
			output-low;
			input-schmitt-enable = <0>;
		};
	};
	gpio215: gpio@215 {
		pins_cmd_dat {
			pins = <PINMUX_GPIO215__FUNC_BPI_BUS3>;
			slew-rate = <1>;
			bias-disable;
			bias-pull-down = <00>;
			output-low;
			input-schmitt-enable = <0>;
		};
	};
	gpio216: gpio@216 {
		pins_cmd_dat {
			pins = <PINMUX_GPIO216__FUNC_MIPI2_SCLK>;
			slew-rate = <1>;
			bias-disable;
			bias-pull-down = <00>;
			output-low;
			input-schmitt-enable = <0>;
		};
	};
	gpio217: gpio@217 {
		pins_cmd_dat {
			pins = <PINMUX_GPIO217__FUNC_MIPI2_SDATA>;
			slew-rate = <1>;
			bias-disable;
			bias-pull-down = <00>;
			output-low;
			input-schmitt-enable = <0>;
		};
	};
	gpio218: gpio@218 {
		pins_cmd_dat {
			pins = <PINMUX_GPIO218__FUNC_MIPI3_SCLK>;
			slew-rate = <1>;
			bias-disable;
			bias-pull-down = <00>;
			output-low;
			input-schmitt-enable = <0>;
		};
	};
	gpio219: gpio@219 {
		pins_cmd_dat {
			pins = <PINMUX_GPIO219__FUNC_MIPI3_SDATA>;
			slew-rate = <1>;
			bias-disable;
			bias-pull-down = <00>;
			output-low;
			input-schmitt-enable = <0>;
		};
	};
	gpio220: gpio@220 {
		pins_cmd_dat {
			pins = <PINMUX_GPIO220__FUNC_CONN_WF_IP>;
			slew-rate = <0>;
			bias-disable;
			bias-pull-down = <00>;
			output-low;
			input-schmitt-enable = <0>;
		};
	};
	gpio221: gpio@221 {
		pins_cmd_dat {
			pins = <PINMUX_GPIO221__FUNC_CONN_WF_IN>;
			slew-rate = <0>;
			bias-disable;
			bias-pull-down = <00>;
			output-low;
			input-schmitt-enable = <0>;
		};
	};
	gpio222: gpio@222 {
		pins_cmd_dat {
			pins = <PINMUX_GPIO222__FUNC_CONN_WF_QP>;
			slew-rate = <0>;
			bias-disable;
			bias-pull-down = <00>;
			output-low;
			input-schmitt-enable = <0>;
		};
	};
	gpio223: gpio@223 {
		pins_cmd_dat {
			pins = <PINMUX_GPIO223__FUNC_CONN_WF_QN>;
			slew-rate = <0>;
			bias-disable;
			bias-pull-down = <00>;
			output-low;
			input-schmitt-enable = <0>;
		};
	};
	gpio224: gpio@224 {
		pins_cmd_dat {
			pins = <PINMUX_GPIO224__FUNC_CONN_BT_IP>;
			slew-rate = <0>;
			bias-disable;
			bias-pull-down = <00>;
			output-low;
			input-schmitt-enable = <0>;
		};
	};
	gpio225: gpio@225 {
		pins_cmd_dat {
			pins = <PINMUX_GPIO225__FUNC_CONN_BT_IN>;
			slew-rate = <0>;
			bias-disable;
			bias-pull-down = <00>;
			output-low;
			input-schmitt-enable = <0>;
		};
	};
	gpio226: gpio@226 {
		pins_cmd_dat {
			pins = <PINMUX_GPIO226__FUNC_CONN_BT_QP>;
			slew-rate = <0>;
			bias-disable;
			bias-pull-down = <00>;
			output-low;
			input-schmitt-enable = <0>;
		};
	};
	gpio227: gpio@227 {
		pins_cmd_dat {
			pins = <PINMUX_GPIO227__FUNC_CONN_BT_QN>;
			slew-rate = <0>;
			bias-disable;
			bias-pull-down = <00>;
			output-low;
			input-schmitt-enable = <0>;
		};
	};
	gpio228: gpio@228 {
		pins_cmd_dat {
			pins = <PINMUX_GPIO228__FUNC_CONN_GPS_IP>;
			slew-rate = <0>;
			bias-disable;
			bias-pull-down = <00>;
			output-low;
			input-schmitt-enable = <0>;
		};
	};
	gpio229: gpio@229 {
		pins_cmd_dat {
			pins = <PINMUX_GPIO229__FUNC_CONN_GPS_IN>;
			slew-rate = <0>;
			bias-disable;
			bias-pull-down = <00>;
			output-low;
			input-schmitt-enable = <0>;
		};
	};
	gpio230: gpio@230 {
		pins_cmd_dat {
			pins = <PINMUX_GPIO230__FUNC_CONN_GPS_QP>;
			slew-rate = <0>;
			bias-disable;
			bias-pull-down = <00>;
			output-low;
			input-schmitt-enable = <0>;
		};
	};
	gpio231: gpio@231 {
		pins_cmd_dat {
			pins = <PINMUX_GPIO231__FUNC_CONN_GPS_QN>;
			slew-rate = <0>;
			bias-disable;
			bias-pull-down = <00>;
			output-low;
			input-schmitt-enable = <0>;
		};
	};
	gpio232: gpio@232 {
		pins_cmd_dat {
			pins = <PINMUX_GPIO232__FUNC_URXD1>;
			slew-rate = <0>;
			
			bias-pull-down = <11>;
			output-low;
			input-schmitt-enable = <1>;
		};
	};
	gpio233: gpio@233 {
		pins_cmd_dat {
			pins = <PINMUX_GPIO233__FUNC_UTXD1>;
			slew-rate = <1>;
			bias-disable;
			bias-pull-down = <00>;
			output-low;
			input-schmitt-enable = <1>;
		};
	};
	gpio234: gpio@234 {
		pins_cmd_dat {
			pins = <PINMUX_GPIO234__FUNC_SPI1_CLK_B>;
			slew-rate = <1>;
			bias-disable;
			bias-pull-down = <00>;
			output-low;
			input-schmitt-enable = <1>;
		};
	};
	gpio235: gpio@235 {
		pins_cmd_dat {
			pins = <PINMUX_GPIO235__FUNC_SPI1_MI_B>;
			slew-rate = <0>;
			bias-disable;
			bias-pull-down = <00>;
			output-low;
			input-schmitt-enable = <1>;
		};
	};
	gpio236: gpio@236 {
		pins_cmd_dat {
			pins = <PINMUX_GPIO236__FUNC_SPI1_MO_B>;
			slew-rate = <1>;
			bias-disable;
			bias-pull-down = <00>;
			output-low;
			input-schmitt-enable = <1>;
		};
	};
	gpio237: gpio@237 {
		pins_cmd_dat {
			pins = <PINMUX_GPIO237__FUNC_SPI1_CS_B>;
			slew-rate = <1>;
			bias-disable;
			bias-pull-down = <00>;
			output-low;
			input-schmitt-enable = <1>;
		};
	};
	gpio238: gpio@238 {
		pins_cmd_dat {
			pins = <PINMUX_GPIO238__FUNC_SDA4_0>;
			slew-rate = <0>;
			bias-disable;
			bias-pull-down = <00>;
			output-low;
			input-schmitt-enable = <0>;
		};
	};
	gpio239: gpio@239 {
		pins_cmd_dat {
			pins = <PINMUX_GPIO239__FUNC_SCL4_0>;
			slew-rate = <0>;
			bias-disable;
			bias-pull-down = <00>;
			output-low;
			input-schmitt-enable = <0>;
		};
	};
	gpio240: gpio@240 {
		pins_cmd_dat {
			pins = <PINMUX_GPIO240__FUNC_SDA5_0>;
			slew-rate = <0>;
			bias-disable;
			bias-pull-down = <00>;
			output-low;
			input-schmitt-enable = <0>;
		};
	};
	gpio241: gpio@241 {
		pins_cmd_dat {
			pins = <PINMUX_GPIO241__FUNC_SCL5_0>;
			slew-rate = <0>;
			bias-disable;
			bias-pull-down = <00>;
			output-low;
			input-schmitt-enable = <0>;
		};
	};
	gpio242: gpio@242 {
		pins_cmd_dat {
			pins = <PINMUX_GPIO242__FUNC_SPI2_CLK_B>;
			slew-rate = <1>;
			bias-disable;
			bias-pull-down = <00>;
			output-low;
			input-schmitt-enable = <1>;
		};
	};
	gpio243: gpio@243 {
		pins_cmd_dat {
			pins = <PINMUX_GPIO243__FUNC_SPI2_MI_B>;
			slew-rate = <0>;
			bias-disable;
			bias-pull-down = <00>;
			output-low;
			input-schmitt-enable = <1>;
		};
	};
	gpio244: gpio@244 {
		pins_cmd_dat {
			pins = <PINMUX_GPIO244__FUNC_SPI2_MO_B>;
			slew-rate = <1>;
			bias-disable;
			bias-pull-down = <00>;
			output-low;
			input-schmitt-enable = <1>;
		};
	};
	gpio245: gpio@245 {
		pins_cmd_dat {
			pins = <PINMUX_GPIO245__FUNC_SPI2_CS_B>;
			slew-rate = <1>;
			bias-disable;
			bias-pull-down = <00>;
			output-low;
			input-schmitt-enable = <1>;
		};
	};
	gpio246: gpio@246 {
		pins_cmd_dat {
			pins = <PINMUX_GPIO246__FUNC_I2S0_LRCK>;
			slew-rate = <1>;
			bias-disable;
			bias-pull-down = <00>;
			output-low;
			input-schmitt-enable = <0>;
		};
	};
	gpio247: gpio@247 {
		pins_cmd_dat {
			pins = <PINMUX_GPIO247__FUNC_I2S0_BCK>;
			slew-rate = <1>;
			bias-disable;
			bias-pull-down = <00>;
			output-low;
			input-schmitt-enable = <0>;
		};
	};
	gpio248: gpio@248 {
		pins_cmd_dat {
			pins = <PINMUX_GPIO248__FUNC_I2S0_DI>;
			slew-rate = <0>;
			
			bias-pull-down = <00>;
			output-low;
			input-schmitt-enable = <0>;
		};
	};
	gpio249: gpio@249 {
		pins_cmd_dat {
			pins = <PINMUX_GPIO249__FUNC_TRAP_SRAM_PWR_BYPASS>;
			slew-rate = <0>;
			bias-disable;
			bias-pull-down = <00>;
			output-low;
			input-schmitt-enable = <0>;
		};
	};
	gpio250: gpio@250 {
		pins_cmd_dat {
			pins = <PINMUX_GPIO250__FUNC_GPIO250>;
			slew-rate = <1>;
			bias-disable;
			bias-pull-down = <00>;
			output-low;
			input-schmitt-enable = <0>;
		};
	};
	gpio251: gpio@251 {
		pins_cmd_dat {
			pins = <PINMUX_GPIO251__FUNC_GPIO251>;
			slew-rate = <1>;
			bias-disable;
			bias-pull-down = <00>;
			output-high;
			input-schmitt-enable = <0>;
		};
	};
	gpio252: gpio@252 {
		pins_cmd_dat {
			pins = <PINMUX_GPIO252__FUNC_GPIO252>;
			slew-rate = <1>;
			bias-disable;
			bias-pull-down = <00>;
			output-low;
			input-schmitt-enable = <0>;
		};
	};
	gpio253: gpio@253 {
		pins_cmd_dat {
			pins = <PINMUX_GPIO253__FUNC_GPIO253>;
			slew-rate = <1>;
			bias-disable;
			bias-pull-down = <00>;
			output-low;
			input-schmitt-enable = <0>;
		};
	};
	gpio254: gpio@254 {
		pins_cmd_dat {
			pins = <PINMUX_GPIO254__FUNC_GPIO254>;
			slew-rate = <1>;
			bias-disable;
			bias-pull-down = <00>;
			output-low;
			input-schmitt-enable = <0>;
		};
	};
	gpio255: gpio@255 {
		pins_cmd_dat {
			pins = <PINMUX_GPIO255__FUNC_GPIO255>;
			slew-rate = <1>;
			bias-disable;
			bias-pull-down = <00>;
			output-low;
			input-schmitt-enable = <0>;
		};
	};
	gpio256: gpio@256 {
		pins_cmd_dat {
			pins = <PINMUX_GPIO256__FUNC_GPIO256>;
			slew-rate = <1>;
			bias-disable;
			bias-pull-down = <00>;
			output-low;
			input-schmitt-enable = <0>;
		};
	};
	gpio257: gpio@257 {
		pins_cmd_dat {
			pins = <PINMUX_GPIO257__FUNC_IO_JTAG_TMS>;
			slew-rate = <0>;
			
			bias-pull-down = <11>;
			output-low;
			input-schmitt-enable = <1>;
		};
	};
	gpio258: gpio@258 {
		pins_cmd_dat {
			pins = <PINMUX_GPIO258__FUNC_IO_JTAG_TCK>;
			slew-rate = <0>;
			
			bias-pull-down = <11>;
			output-low;
			input-schmitt-enable = <1>;
		};
	};
	gpio259: gpio@259 {
		pins_cmd_dat {
			pins = <PINMUX_GPIO259__FUNC_IO_JTAG_TDI>;
			slew-rate = <0>;
			
			bias-pull-down = <11>;
			output-low;
			input-schmitt-enable = <1>;
		};
	};
	gpio260: gpio@260 {
		pins_cmd_dat {
			pins = <PINMUX_GPIO260__FUNC_IO_JTAG_TDO>;
			slew-rate = <1>;
			bias-disable;
			bias-pull-down = <00>;
			output-low;
			input-schmitt-enable = <1>;
		};
	};
	gpio261: gpio@261 {
		pins_cmd_dat {
			pins = <PINMUX_GPIO261__FUNC_GPIO261>;
			slew-rate = <0>;
			bias-disable;
			bias-pull-down = <00>;
			output-low;
			input-schmitt-enable = <1>;
		};
	};
};

&gpio {
	pinctrl-names = "default","gpio0","gpio1","gpio2","gpio3","gpio4","gpio5","gpio6","gpio7","gpio8",
"gpio9","gpio10","gpio11","gpio12","gpio13","gpio14","gpio15","gpio16","gpio17","gpio18","gpio19","gpio20",
"gpio21","gpio22","gpio23","gpio24","gpio25","gpio26","gpio27","gpio28","gpio29","gpio30","gpio31","gpio32",
"gpio33","gpio34","gpio35","gpio36","gpio37","gpio38","gpio39","gpio40","gpio41","gpio42","gpio43","gpio44",
"gpio45","gpio46","gpio47","gpio48","gpio49","gpio50","gpio51","gpio52","gpio53","gpio54","gpio55","gpio56",
"gpio57","gpio58","gpio59","gpio60","gpio61","gpio62","gpio63","gpio64","gpio65","gpio66","gpio67","gpio68",
"gpio69","gpio70","gpio71","gpio72","gpio73","gpio74","gpio75","gpio76","gpio77","gpio78","gpio79","gpio80",
"gpio81","gpio82","gpio83","gpio84","gpio85","gpio86","gpio87","gpio88","gpio89","gpio90","gpio91","gpio92",
"gpio93","gpio94","gpio95","gpio96","gpio97","gpio98","gpio99","gpio100","gpio101","gpio102","gpio103",
"gpio104","gpio105","gpio106","gpio107","gpio108","gpio109","gpio110","gpio111","gpio112","gpio113","gpio114",
"gpio115","gpio116","gpio117","gpio118","gpio119","gpio120","gpio121","gpio122","gpio123","gpio124","gpio125",
"gpio126","gpio127","gpio128","gpio129","gpio130","gpio131","gpio132","gpio133","gpio134","gpio135","gpio136",
"gpio137","gpio138","gpio139","gpio140","gpio141","gpio142","gpio143","gpio144","gpio145","gpio146","gpio147",
"gpio148","gpio149","gpio150","gpio151","gpio152","gpio153","gpio154","gpio155","gpio156","gpio157","gpio158",
"gpio159","gpio160","gpio161","gpio162","gpio163","gpio164","gpio165","gpio166","gpio167","gpio168","gpio169",
"gpio170","gpio171","gpio172","gpio173","gpio174","gpio175","gpio176","gpio177","gpio178","gpio179","gpio180",
"gpio181","gpio182","gpio183","gpio184","gpio185","gpio186","gpio187","gpio188","gpio189","gpio190","gpio191",
"gpio192","gpio193","gpio194","gpio195","gpio196","gpio197","gpio198","gpio199","gpio200","gpio201","gpio202",
"gpio203","gpio204","gpio205","gpio206","gpio207","gpio208","gpio209","gpio210","gpio211","gpio212","gpio213",
"gpio214","gpio215","gpio216","gpio217","gpio218","gpio219","gpio220","gpio221","gpio222","gpio223","gpio224",
"gpio225","gpio226","gpio227","gpio228","gpio229","gpio230","gpio231","gpio232","gpio233","gpio234","gpio235",
"gpio236","gpio237","gpio238","gpio239","gpio240","gpio241","gpio242","gpio243","gpio244","gpio245","gpio246",
"gpio247","gpio248","gpio249","gpio250","gpio251","gpio252","gpio253","gpio254","gpio255","gpio256","gpio257",
"gpio258","gpio259","gpio260","gpio261";
	pinctrl-0 = <&gpio_pins_default>;
	pinctrl-1 = <&gpio0>;
	pinctrl-2 = <&gpio1>;
	pinctrl-3 = <&gpio2>;
	pinctrl-4 = <&gpio3>;
	pinctrl-5 = <&gpio4>;
	pinctrl-6 = <&gpio5>;
	pinctrl-7 = <&gpio6>;
	pinctrl-8 = <&gpio7>;
	pinctrl-9 = <&gpio8>;
	pinctrl-10 = <&gpio9>;
	pinctrl-11 = <&gpio10>;
	pinctrl-12 = <&gpio11>;
	pinctrl-13 = <&gpio12>;
	pinctrl-14 = <&gpio13>;
	pinctrl-15 = <&gpio14>;
	pinctrl-16 = <&gpio15>;
	pinctrl-17 = <&gpio16>;
	pinctrl-18 = <&gpio17>;
	pinctrl-19 = <&gpio18>;
	pinctrl-20 = <&gpio19>;
	pinctrl-21 = <&gpio20>;
	pinctrl-22 = <&gpio21>;
	pinctrl-23 = <&gpio22>;
	pinctrl-24 = <&gpio23>;
	pinctrl-25 = <&gpio24>;
	pinctrl-26 = <&gpio25>;
	pinctrl-27 = <&gpio26>;
	pinctrl-28 = <&gpio27>;
	pinctrl-29 = <&gpio28>;
	pinctrl-30 = <&gpio29>;
	pinctrl-31 = <&gpio30>;
	pinctrl-32 = <&gpio31>;
	pinctrl-33 = <&gpio32>;
	pinctrl-34 = <&gpio33>;
	pinctrl-35 = <&gpio34>;
	pinctrl-36 = <&gpio35>;
	pinctrl-37 = <&gpio36>;
	pinctrl-38 = <&gpio37>;
	pinctrl-39 = <&gpio38>;
	pinctrl-40 = <&gpio39>;
	pinctrl-41 = <&gpio40>;
	pinctrl-42 = <&gpio41>;
	pinctrl-43 = <&gpio42>;
	pinctrl-44 = <&gpio43>;
	pinctrl-45 = <&gpio44>;
	pinctrl-46 = <&gpio45>;
	pinctrl-47 = <&gpio46>;
	pinctrl-48 = <&gpio47>;
	pinctrl-49 = <&gpio48>;
	pinctrl-50 = <&gpio49>;
	pinctrl-51 = <&gpio50>;
	pinctrl-52 = <&gpio51>;
	pinctrl-53 = <&gpio52>;
	pinctrl-54 = <&gpio53>;
	pinctrl-55 = <&gpio54>;
	pinctrl-56 = <&gpio55>;
	pinctrl-57 = <&gpio56>;
	pinctrl-58 = <&gpio57>;
	pinctrl-59 = <&gpio58>;
	pinctrl-60 = <&gpio59>;
	pinctrl-61 = <&gpio60>;
	pinctrl-62 = <&gpio61>;
	pinctrl-63 = <&gpio62>;
	pinctrl-64 = <&gpio63>;
	pinctrl-65 = <&gpio64>;
	pinctrl-66 = <&gpio65>;
	pinctrl-67 = <&gpio66>;
	pinctrl-68 = <&gpio67>;
	pinctrl-69 = <&gpio68>;
	pinctrl-70 = <&gpio69>;
	pinctrl-71 = <&gpio70>;
	pinctrl-72 = <&gpio71>;
	pinctrl-73 = <&gpio72>;
	pinctrl-74 = <&gpio73>;
	pinctrl-75 = <&gpio74>;
	pinctrl-76 = <&gpio75>;
	pinctrl-77 = <&gpio76>;
	pinctrl-78 = <&gpio77>;
	pinctrl-79 = <&gpio78>;
	pinctrl-80 = <&gpio79>;
	pinctrl-81 = <&gpio80>;
	pinctrl-82 = <&gpio81>;
	pinctrl-83 = <&gpio82>;
	pinctrl-84 = <&gpio83>;
	pinctrl-85 = <&gpio84>;
	pinctrl-86 = <&gpio85>;
	pinctrl-87 = <&gpio86>;
	pinctrl-88 = <&gpio87>;
	pinctrl-89 = <&gpio88>;
	pinctrl-90 = <&gpio89>;
	pinctrl-91 = <&gpio90>;
	pinctrl-92 = <&gpio91>;
	pinctrl-93 = <&gpio92>;
	pinctrl-94 = <&gpio93>;
	pinctrl-95 = <&gpio94>;
	pinctrl-96 = <&gpio95>;
	pinctrl-97 = <&gpio96>;
	pinctrl-98 = <&gpio97>;
	pinctrl-99 = <&gpio98>;
	pinctrl-100 = <&gpio99>;
	pinctrl-101 = <&gpio100>;
	pinctrl-102 = <&gpio101>;
	pinctrl-103 = <&gpio102>;
	pinctrl-104 = <&gpio103>;
	pinctrl-105 = <&gpio104>;
	pinctrl-106 = <&gpio105>;
	pinctrl-107 = <&gpio106>;
	pinctrl-108 = <&gpio107>;
	pinctrl-109 = <&gpio108>;
	pinctrl-110 = <&gpio109>;
	pinctrl-111 = <&gpio110>;
	pinctrl-112 = <&gpio111>;
	pinctrl-113 = <&gpio112>;
	pinctrl-114 = <&gpio113>;
	pinctrl-115 = <&gpio114>;
	pinctrl-116 = <&gpio115>;
	pinctrl-117 = <&gpio116>;
	pinctrl-118 = <&gpio117>;
	pinctrl-119 = <&gpio118>;
	pinctrl-120 = <&gpio119>;
	pinctrl-121 = <&gpio120>;
	pinctrl-122 = <&gpio121>;
	pinctrl-123 = <&gpio122>;
	pinctrl-124 = <&gpio123>;
	pinctrl-125 = <&gpio124>;
	pinctrl-126 = <&gpio125>;
	pinctrl-127 = <&gpio126>;
	pinctrl-128 = <&gpio127>;
	pinctrl-129 = <&gpio128>;
	pinctrl-130 = <&gpio129>;
	pinctrl-131 = <&gpio130>;
	pinctrl-132 = <&gpio131>;
	pinctrl-133 = <&gpio132>;
	pinctrl-134 = <&gpio133>;
	pinctrl-135 = <&gpio134>;
	pinctrl-136 = <&gpio135>;
	pinctrl-137 = <&gpio136>;
	pinctrl-138 = <&gpio137>;
	pinctrl-139 = <&gpio138>;
	pinctrl-140 = <&gpio139>;
	pinctrl-141 = <&gpio140>;
	pinctrl-142 = <&gpio141>;
	pinctrl-143 = <&gpio142>;
	pinctrl-144 = <&gpio143>;
	pinctrl-145 = <&gpio144>;
	pinctrl-146 = <&gpio145>;
	pinctrl-147 = <&gpio146>;
	pinctrl-148 = <&gpio147>;
	pinctrl-149 = <&gpio148>;
	pinctrl-150 = <&gpio149>;
	pinctrl-151 = <&gpio150>;
	pinctrl-152 = <&gpio151>;
	pinctrl-153 = <&gpio152>;
	pinctrl-154 = <&gpio153>;
	pinctrl-155 = <&gpio154>;
	pinctrl-156 = <&gpio155>;
	pinctrl-157 = <&gpio156>;
	pinctrl-158 = <&gpio157>;
	pinctrl-159 = <&gpio158>;
	pinctrl-160 = <&gpio159>;
	pinctrl-161 = <&gpio160>;
	pinctrl-162 = <&gpio161>;
	pinctrl-163 = <&gpio162>;
	pinctrl-164 = <&gpio163>;
	pinctrl-165 = <&gpio164>;
	pinctrl-166 = <&gpio165>;
	pinctrl-167 = <&gpio166>;
	pinctrl-168 = <&gpio167>;
	pinctrl-169 = <&gpio168>;
	pinctrl-170 = <&gpio169>;
	pinctrl-171 = <&gpio170>;
	pinctrl-172 = <&gpio171>;
	pinctrl-173 = <&gpio172>;
	pinctrl-174 = <&gpio173>;
	pinctrl-175 = <&gpio174>;
	pinctrl-176 = <&gpio175>;
	pinctrl-177 = <&gpio176>;
	pinctrl-178 = <&gpio177>;
	pinctrl-179 = <&gpio178>;
	pinctrl-180 = <&gpio179>;
	pinctrl-181 = <&gpio180>;
	pinctrl-182 = <&gpio181>;
	pinctrl-183 = <&gpio182>;
	pinctrl-184 = <&gpio183>;
	pinctrl-185 = <&gpio184>;
	pinctrl-186 = <&gpio185>;
	pinctrl-187 = <&gpio186>;
	pinctrl-188 = <&gpio187>;
	pinctrl-189 = <&gpio188>;
	pinctrl-190 = <&gpio189>;
	pinctrl-191 = <&gpio190>;
	pinctrl-192 = <&gpio191>;
	pinctrl-193 = <&gpio192>;
	pinctrl-194 = <&gpio193>;
	pinctrl-195 = <&gpio194>;
	pinctrl-196 = <&gpio195>;
	pinctrl-197 = <&gpio196>;
	pinctrl-198 = <&gpio197>;
	pinctrl-199 = <&gpio198>;
	pinctrl-200 = <&gpio199>;
	pinctrl-201 = <&gpio200>;
	pinctrl-202 = <&gpio201>;
	pinctrl-203 = <&gpio202>;
	pinctrl-204 = <&gpio203>;
	pinctrl-205 = <&gpio204>;
	pinctrl-206 = <&gpio205>;
	pinctrl-207 = <&gpio206>;
	pinctrl-208 = <&gpio207>;
	pinctrl-209 = <&gpio208>;
	pinctrl-210 = <&gpio209>;
	pinctrl-211 = <&gpio210>;
	pinctrl-212 = <&gpio211>;
	pinctrl-213 = <&gpio212>;
	pinctrl-214 = <&gpio213>;
	pinctrl-215 = <&gpio214>;
	pinctrl-216 = <&gpio215>;
	pinctrl-217 = <&gpio216>;
	pinctrl-218 = <&gpio217>;
	pinctrl-219 = <&gpio218>;
	pinctrl-220 = <&gpio219>;
	pinctrl-221 = <&gpio220>;
	pinctrl-222 = <&gpio221>;
	pinctrl-223 = <&gpio222>;
	pinctrl-224 = <&gpio223>;
	pinctrl-225 = <&gpio224>;
	pinctrl-226 = <&gpio225>;
	pinctrl-227 = <&gpio226>;
	pinctrl-228 = <&gpio227>;
	pinctrl-229 = <&gpio228>;
	pinctrl-230 = <&gpio229>;
	pinctrl-231 = <&gpio230>;
	pinctrl-232 = <&gpio231>;
	pinctrl-233 = <&gpio232>;
	pinctrl-234 = <&gpio233>;
	pinctrl-235 = <&gpio234>;
	pinctrl-236 = <&gpio235>;
	pinctrl-237 = <&gpio236>;
	pinctrl-238 = <&gpio237>;
	pinctrl-239 = <&gpio238>;
	pinctrl-240 = <&gpio239>;
	pinctrl-241 = <&gpio240>;
	pinctrl-242 = <&gpio241>;
	pinctrl-243 = <&gpio242>;
	pinctrl-244 = <&gpio243>;
	pinctrl-245 = <&gpio244>;
	pinctrl-246 = <&gpio245>;
	pinctrl-247 = <&gpio246>;
	pinctrl-248 = <&gpio247>;
	pinctrl-249 = <&gpio248>;
	pinctrl-250 = <&gpio249>;
	pinctrl-251 = <&gpio250>;
	pinctrl-252 = <&gpio251>;
	pinctrl-253 = <&gpio252>;
	pinctrl-254 = <&gpio253>;
	pinctrl-255 = <&gpio254>;
	pinctrl-256 = <&gpio255>;
	pinctrl-257 = <&gpio256>;
	pinctrl-258 = <&gpio257>;
	pinctrl-259 = <&gpio258>;
	pinctrl-260 = <&gpio259>;
	pinctrl-261 = <&gpio260>;

	status = "okay";
};

