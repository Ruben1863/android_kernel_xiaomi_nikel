/*
 * Generated by MTK SP DrvGen Version: 2.2.160113 for MT6797. Copyright MediaTek Inc. (C) 2015.
 * 01.26.2023 12:49:49
 * Do Not Modify the File.
 */

/*************************
 * GPIO_USAGE_MAPPING DTSI File
*************************/

&gpio_usage_mapping {
	GPIO_SIM1_HOT_PLUG = <112>;
	GPIO_SIM2_HOT_PLUG = <113>;
	GPIO_SIM1_SCLK = <126>;
	GPIO_SIM1_SRST = <127>;
	GPIO_SIM1_SIO = <128>;
	GPIO_SIM2_SCLK = <155>;
	GPIO_SIM2_SRST = <156>;
	GPIO_SIM2_SIO = <157>;
	GPIO_FDD_BAND_SUPPORT_DETECT_1ST_PIN = <194>;
	GPIO_FDD_BAND_SUPPORT_DETECT_2ND_PIN = <195>;
};

