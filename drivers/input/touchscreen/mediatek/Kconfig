## drivers/input/touchscreen/mediatek/Kconfig
```kconfig
#
# Touchscreen driver configuration
#
menuconfig INPUT_TOUCHSCREEN
	bool "Touchscreens"
	help
	  Say Y here, and a list of supported touchscreens will be displayed.
	  This option doesn't affect the kernel.

	  If unsure, say Y.

if INPUT_TOUCHSCREEN

config TOUCHSCREEN_MTK
	bool "MediaTek Touch Panel Driver"
	help
	  Say Y here if you have MediaTek touch panel.

	  If unsure, say N.

	  To compile this dirver as a module, choose M here: the
	  module will be called.

config TOUCHSCREEN_MTK_FT5346
	bool "FT5346 for Mediatek package"
	default n
	help
	  Say Y here if you have focaltech_touch touch panel.

	  If unsure, say N.

	  To compile this dirver as a module, choose M here: the
	  module will be called.

source "drivers/input/touchscreen/mediatek/ft5346/Kconfig"
endif
```

## drivers/input/touchscreen/mediatek/ft5346/Kconfig
```kconfig
#
# Touchscreen driver configuration
#

config TP_SIMULATE_SWITCH
	bool "Tp_simulate_switch"
	default n
	help
	  Say Y here if you want to open the switch function.

	  If you donnot, say N.

if TOUCHSCREEN_MTK_FT5346

config FT5346_FIRMWARE
	string "FT5346 for Mediatek firmware"

config TPD_ROTATE_90
	bool "ft5346 for Mediatek package"
	default n
	help
	Say Y here if you have ft5346 touch panel TPD_ROTATE_90.

	If unsure, say N.

	To compile this dirver as a module, choose M here: the
	module will be called.

config TPD_ROTATE_180
	bool "ft5346 for Mediatek package"
	default n
	help
	Say Y here if you have ft5346 touch panel TPD_ROTATE_180.

	If unsure, say N.

	To compile this dirver as a module, choose M here: the
	module will be called.

config TPD_ROTATE_270
	bool "ft5346 for Mediatek package"
	default n
	help
	Say Y here if you have ft5346 touch panel TPD_ROTATE_270.

	If unsure, say N.

	To compile this dirver as a module, choose M here: the
	module will be called.

config FT_AUTO_UPGRADE_SUPPORT
	bool "ft5346 for Mediatek package"
	default n
	help
	Say Y here if you have ft5346 touch panel FT_AUTO_UPGRADE_SUPPORT.

	If unsure, say N.

	To compile this dirver as a module, choose M here: the
	module will be called.

config CUST_FTS_APK_DEBUG
	bool "ft5346 for Mediatek package"
	default n
	help
	Say Y here if you have ft5346 touch panel CUST_FTS_APK_DEBUG.

	If unsure, say N.

	To compile this dirver as a module, choose M here: the
	module will be called.

config TPD_HAVE_CALIBRATION
	bool "ft5346 for Mediatek package"
	default n
	help
	Say Y here if you have ft5346 touch panel TPD_HAVE_CALIBRATION.

	If unsure, say N.

	To compile this dirver as a module, choose M here: the
	module will be called.

config TPD_CUSTOM_CALIBRATION
	bool "ft5346 for Mediatek package"
	default n
	help
	Say Y here if you have ft5346 touch panel TPD_CUSTOM_CALIBRATION.

	If unsure, say N.

	To compile this dirver as a module, choose M here: the
	module will be called.
endif
```

## drivers/misc/mediatek/battery_fual/Kconfig
```kconfig
config FG_CW2015_BATTERY_SUPPORT
        bool "support cw2015 driver for RN4X"
        default n
        help
         Devoloped by ruben1863
```
